#include "header.h"

uchar speedvalue;	//数度设定值
/*******************************************************************************
* 函数名         : Delay10us()
* 函数功能		 : 延时10us
* 输入           : 无
* 输出         	 : 无
*******************************************************************************/

void Delay10us()
{
	unsigned char a,b;
	for(b=1;b>0;b--)
		for(a=2;a>0;a--);

}

/*******************************************************************************
* 函数名         : I2cStartDistinguish()
* 函数功能		 : 识别起始信号
* 输入           : 无
* 输出         	 : 无
*******************************************************************************/
uchar I2cStartDistinguish()
{
	SDA = 1;
	SCL = 1;
	while((SCL == 1) && (SDA == 1))
	{  
		while((SCL == 1) && (SDA == 1));
		while((SCL == 1) && (SDA == 0))
		{	 
			while((SCL == 1) && (SDA == 0));
			return 1;	
		}
		
	}
	
	return 0;
}

/*******************************************************************************
* 函数名         : I2cStopDistinguish()
* 函数功能		 : 识别终止信号
* 输入           : 无
* 输出         	 : 无
*******************************************************************************/
uchar I2cStopDistinguish()
{
	while((SCL == 1) && (SDA == 0))
	{
		while((SCL == 1) && (SDA == 0));
		while((SCL == 1) && (SDA == 1))
		{
			while((SCL == 1) && (SDA == 1));
			return 1;	
		}
		
	}
	return 0;	
}

/*******************************************************************************
* 函数名         : ReceiveByte()
* 函数功能		 : 接收一个字节的数据
* 输入           : 无
* 输出         	 : 无
*******************************************************************************/
uchar ReceiveByte()
{
	unsigned char a,dat;
	SDA=1;			//起始和发送一个字节之后SCL都是0
	Delay10us();
	for(a=0;a<8;a++)//接收8个字节
	{
		SCL=1;
		Delay10us();
		dat<<=1;
		dat|=SDA;
		Delay10us();
		SCL=0;
		Delay10us();
	}
	
	SDA = 0;
	Delay10us();
	Delay10us();
	SDA = 1;
	return dat;
}

/*******************************************************************************
* 函数名         : Receive()
* 函数功能		 : 接收速度设定值
* 输入           : 无
* 输出         	 : 无
*******************************************************************************/
void Receive()
{
	uchar a = 200;
	if(I2cStartDistinguish() == 1)		 //判断是否接收到起始信号
	{	
		if(ReceiveByte() == 0x00)		 //判断是否为写器件地址
		{							 	
			if(ReceiveByte() == 0x01)	 //判断是否为数据接收地址
		    {		
				speedvalue = ReceiveByte();	   //接收数据
				a = 200;
				while((I2cStopDistinguish() == 0) && (a > 0))	//当接收到停止信号时跳出循环
				{
					a--;
				}
		    }	
		}
	}	
}



